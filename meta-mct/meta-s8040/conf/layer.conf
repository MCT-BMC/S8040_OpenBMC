## meta-mct/meta-s8040/conf/layer.conf
```bitbake
# We have a conf and classes directory, add to BBPATH
BBPATH .= ":${LAYERDIR}"

# We have recipes-* directories, add to BBFILES
BBFILES += "${LAYERDIR}/recipes-*/*/*.bb \
	${LAYERDIR}/recipes-*/*/*.bbappend"

BBFILE_COLLECTIONS += "s8040"
BBFILE_PATTERN_s8040 = "^${LAYERDIR}/"
BBFILE_PRIORITY_s8040 = "6"

LAYERSERIES_COMPAT_s8040 = "gatesgarth hardknott"
```

## meta-mct/meta-s8047/conf/layer.conf
```bitbake
# We have a conf and classes directory, add to BBPATH
BBPATH .= ":${LAYERDIR}"

# We have recipes-* directories, add to BBFILES
BBFILES += "${LAYERDIR}/recipes-*/*/*.bb \
	${LAYERDIR}/recipes-*/*/*.bbappend"

BBFILE_COLLECTIONS += "s8047"
BBFILE_PATTERN_s8047 = "^${LAYERDIR}/"
BBFILE_PRIORITY_s8047 = "6"

LAYERSERIES_COMPAT_s8047 = "gatesgarth hardknott"
```

## meta-mct/meta-s8047/conf/machine/s8047.conf
```bitbake
KMACHINE = "aspeed"
KERNEL_DEVICETREE = "${KMACHINE}-bmc-amd-shale.dtb \
                     ${KMACHINE}-bmc-amd-cinnabar.dtb \
                     ${KMACHINE}-bmc-amd-sunstone.dtb \
                    "

UBOOT_MACHINE_s8047 = "ast2600_openbmc_defconfig"
UBOOT_DEVICETREE = "ast2600-hawaii"

require conf/machine/include/ast2600.inc
require conf/machine/include/obmc-bsp-common.inc

SERIAL_CONSOLES = "115200;ttyS4"

# Overwrite flash offsets
FLASH_SIZE = "65536"
FLASH_UBOOT_OFFSET = "0"
FLASH_KERNEL_OFFSET = "1024"
FLASH_UBI_OFFSET = "${FLASH_KERNEL_OFFSET}"
FLASH_ROFS_OFFSET = "6144"
FLASH_RWFS_OFFSET = "49152"


OBMC_MACHINE_FEATURES += "\
        obmc-bmc-state-mgmt \
        obmc-chassis-state-mgmt \
        obmc-host-ipmi \
        obmc-host-state-mgmt \
        obmc-phosphor-chassis-mgmt \
        obmc-phosphor-flash-mgmt \
        "

VIRTUAL-RUNTIME_obmc-host-state-manager ?= "amd-power-control"
VIRTUAL-RUNTIME_obmc-chassis-state-manager ?= "amd-power-control"

PREFERRED_PROVIDER_virtual/obmc-chassis-mgmt = "packagegroup-amd-apps"
PREFERRED_PROVIDER_virtual/obmc-host-ipmi-hw ?= "phosphor-ipmi-kcs"
PREFERRED_PROVIDER_virtual/obmc-system-mgmt = "packagegroup-amd-apps"
PREFERRED_PROVIDER_virtual/obmc-flash-mgmt = "packagegroup-amd-apps"
PREFERRED_PROVIDER_virtual/phosphor-led-manager-config-native = "sp6-led-manager-config-native"
PREFERRED_PROVIDER_virtual/phosphor-ipmi-fru-hostfw-config ?= "hostboot-inventory-config-native"

OVERRIDES .= ":amd"
```

## meta-mct/meta-s8050/conf/layer.conf
```bitbake
# We have a conf and classes directory, add to BBPATH
BBPATH .= ":${LAYERDIR}"

# We have recipes-* directories, add to BBFILES
BBFILES += "${LAYERDIR}/recipes-*/*/*.bb \
	${LAYERDIR}/recipes-*/*/*.bbappend"

BBFILE_COLLECTIONS += "s8050"
BBFILE_PATTERN_s8050 = "^${LAYERDIR}/"
BBFILE_PRIORITY_s8050 = "6"

LAYERSERIES_COMPAT_s8050 = "gatesgarth hardknott"
```
